## esp-panel/main/Kconfig.projbuild.sample
```kconfig
menu "WiFi Configuration"

    config WIFI_SSID
        string "WiFi SSID"
        default "<your WiFi SSID>"
        help
            WiFi network name

    config WIFI_PASSWORD
        string "WiFi Password"
        default "<your WiFi password>"
        help
            WiFi network password

endmenu

menu "Network Configuration"

    config RPI_IP_ADDRESS
        string "RPi IP Address"
        default "<your RPi IP address>"
        help
            IP address of the Raspberry Pi dispatcher

    config ESP_DEVICE_ID
        string "ESP Device ID"
        default "ESP_Gyrocompass"
        help
            Unique identifier for this ESP32 device

endmenu

menu "Instrument Configuration"

    choice INSTRUMENT_TYPE
        prompt "Select Instrument Type"
        default INSTRUMENT_AIRSPEED
        help
            Choose which instrument this ESP will control

        config INSTRUMENT_AIRSPEED
            bool "Airspeed Indicator"
            help
                0-200 knots analog indicator

        config INSTRUMENT_GYRO_COMPASS
            bool "Gyro Compass / Heading"
            help
                0-360 degree heading indicator

    endchoice

endmenu
```

## esp-panel/sdkconfig.defaults.esp32c3.sample
```kconfig
CONFIG_INSTRUMENT_GYRO_COMPASS=y
CONFIG_ESP_DEVICE_ID="ESP_GyroCompass"
CONFIG_RPI_IP_ADDRESS="<your RPi IP address>"
CONFIG_WIFI_SSID="<your WiFi network SSID>"
CONFIG_WIFI_PASSWORD="<your WiFi password>"
```
